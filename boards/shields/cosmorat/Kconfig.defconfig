## boards/shields/cosmorat/Kconfig.defconfig
```kconfig
if SHIELD_COSMORAT_RIGHT
    config SPI
        default y
    config ZMK_POINTING
        default y
endif

if SHIELD_COSMORAT_LEFT
    config ZMK_SPLIT_ROLE_CENTRAL
        default y
    config ZMK_POINTING
        default y
endif
```

## boards/shields/cosmorat/Kconfig.shield
```kconfig
config SHIELD_COSMORAT_LEFT
	def_bool $(shields_list_contains,cosmorat_left)

config SHIELD_COSMORAT_RIGHT
	def_bool $(shields_list_contains,cosmorat_right)

config SHIELD_COSMORAT_DONGLE
	def_bool $(shields_list_contains,cosmorat_dongle)
```

## boards/shields/cosmorat/dts/bindings/sensor/pixart,pmw3360.yaml
```yaml
description: Pixart PMW3360 optical motion sensor

compatible: "pixart,pmw3360"

include: spi-device.yaml

properties:
  reg:
    required: true

  spi-max-frequency:
    type: int
    required: true

  irq-gpios:
    type: phandle-array
    required: true

  dr-gpios:
    type: phandle-array
    required: true 
```

## config/west.yml
```yaml
manifest:
  remotes:
    - name: zmkfirmware
      url-base: https://github.com/zmkfirmware
    - name: cosmorat
      url-base: https://github.com/Cuttlerat
    # Additional modules containing boards/shields/custom code can be listed here as well
    # See https://docs.zephyrproject.org/3.2.0/develop/west/manifest.html#projects
  projects:
    - name: zmk
      remote: zmkfirmware
      revision: main
      import: app/west.yml
    - name: zmk-keyboard-cosmorat
      remote: cosmorat
      revision: main
  self:
    path: config
```
